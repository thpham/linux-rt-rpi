/dts-v1/;
/plugin/;

/ {
        compatible = "brcm,bcm2709";

        fragment@0 {
                target = <&i2c1>;
                __overlay__ {
                        #address-cells = <1>;
                        #size-cells = <0>;
                        status = "okay";

                        ms5611@77 {
                                compatible = "ms5611";
                                reg = <0x77>;
                                status = "okay";
                        };
                };
        };
};
