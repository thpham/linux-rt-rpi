/dts-v1/;
/plugin/;

/ {
        compatible = "brcm,bcm2709";

        fragment@0 {
                target = <&spi1>;
                __overlay__ {
                        #address-cells = <1>;
                        #size-cells = <0>;
                        status = "okay";

                        spidev@0{
                            compatible = "spidev";
                            reg = <0>;	/* CE0 */
                            #address-cells = <1>;
                            #size-cells = <0>;
                            spi-max-frequency = <2000000>;
                        };
                };
        };
};
